#include "znaki.h"
#include "wyswietlanie.h"


#include <Adafruit_NeoPixel.h>
#include <string.h>
#include<math.h>


#define BUTTON_PIN   11
#define PIXEL_PIN 8
#define PIXEL_COUNT 17

int licznik =  0;
int klatka = 250;
unsigned long poprzedniCzas = 0;
unsigned long czas = 0;
unsigned long czasObrotu = 0;
uint32_t czasOpoznienia = 0;
int bitmapa[50][50] = {
    {0, 0, 0, 0, 0, 0, 0, 0, 1, 1, 1, 1, 1, 1, 1, 1, 0, 0, 0, 0, 0, 0, 0, 0, 1, 1, 1, 1, 1, 1, 1, 1, 0, 0, 0, 0, 0, 0, 0, 0, 1, 1, 1, 1, 1, 1, 1, 1, 0, 0},
  {0, 0, 0, 0, 0, 0, 0, 0, 1, 1, 1, 1, 1, 1, 1, 1, 0, 0, 0, 0, 0, 0, 0, 0, 1, 1, 1, 1, 1, 1, 1, 1, 0, 0, 0, 0, 0, 0, 0, 0, 1, 1, 1, 1, 1, 1, 1, 1, 0, 0},
  {0, 0, 0, 0, 0, 0, 0, 0, 1, 1, 1, 1, 1, 1, 1, 1, 0, 0, 0, 0, 0, 0, 0, 0, 1, 1, 1, 1, 1, 1, 1, 1, 0, 0, 0, 0, 0, 0, 0, 0, 1, 1, 1, 1, 1, 1, 1, 1, 0, 0},
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  {0, 0, 0, 0, 0, 0, 0, 0, 1, 1, 1, 1, 1, 1, 1, 1, 0, 0, 0, 0, 0, 0, 0, 0, 1, 1, 1, 1, 1, 1, 1, 1, 0, 0, 0, 0, 0, 0, 0, 0, 1, 1, 1, 1, 1, 1, 1, 1, 0, 0},
};

int matrix[16][108] = {
    {1,0,1,1,0,1,0,1,0,1,0,1,0,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0,0},
    {1,0,1,1,0,1,0,1,1,0,1,1,1,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0,0},
    {1,1,0,1,1,0,1,1,0,1,0,1,0,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0,0},
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    {1,1,1,1,1,1,1,1,1,1,1,1,0,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0,0}
};


int bitmapa_przeksztalcona[108][34] = {0};


// Parameter 1 = number of pixels in strip,  neopixel stick has 8
// Parameter 2 = pin number (most are valid)
// Parameter 3 = pixel type flags, add together as needed:
//   NEO_RGB     Pixels are wired for RGB bitstream
//   NEO_GRB     Pixels are wired for GRB bitstream, correct for neopixel stick
//   NEO_KHZ400  400 KHz bitstream (e.g. FLORA pixels)
//   NEO_KHZ800  800 KHz bitstream (e.g. High Density LED strip), correct for neopixel stick
Adafruit_NeoPixel strip = Adafruit_NeoPixel(PIXEL_COUNT, PIXEL_PIN, NEO_GRB + NEO_KHZ800);

void setup() {
  pinMode(BUTTON_PIN, INPUT_PULLUP);
  pinMode(A2, INPUT);
  strip.begin();
  strip.show();
  PrzeksztalcBitmape();
}
bool wyswietl = true;

void loop() {
  if((analogRead(A2) < 470) && wyswietl){
  //while(true){
    czas = micros();
    //licznik = Animacja(czasOpoznienia, licznik, klatka);
    //Wyswietl(czasOpoznienia, "zupa", "halo");

// liczenie predkosci
/*******************************************/
    /*czasObrotu = czas - poprzedniCzas;

    char predkosc[10] = "";
    sprintf(predkosc, "%lu", czasObrotu); // %lu = unsigned long
    Wyswietl(750, "wzor", predkosc);

    poprzedniCzas = czas;*/

/*******************************************/


// regulacja opoznienia
/*******************************************/
    czasObrotu = czas - poprzedniCzas;
    //float x = 0.00001666;
    float a = 0.023125;
    float b = 968.75;
    float wynik = czasObrotu * a - b; 
    czasOpoznienia = static_cast<uint32_t>(wynik);
    czasOpoznienia = 300;
    /****************/
    char opoznienie[10] = "";
    //sprintf(opoznienie, "%lu", czasOpoznienia); 
    // %lu = unsigned long
    /**************/
/*******************************************/

    FunkcjaKtoraWyswietlaCalaMacierz(czasOpoznienia);
    //Wyswietl(czasOpoznienia, "wzor", "a");
    poprzedniCzas = czas;

/******************************************/
  //wyswietl = false;
  }
  // if((analogRead(A2) < 470) && !wyswietl){
  //   delayMicroseconds(10000);
  //   wyswietl = true;
  // }
}

void FunkcjaKtoraWyswietlaCalaMacierz(uint32_t opoznienie)
{
  uint32_t color = strip.Color(250, 0, 0);
  for(int j=0; j<108; j++)
  {
    //if(analogRead(A2) > 470)
    //{
      for(int i=0; i<strip.numPixels(); i++)
      {
        WyswietlBitmape(j, i, color);
      }
    //}
    //else{break;}
    strip.show();
    //delay(wait);
    if(opoznienie>4000){opoznienie = 4000;}
    delayMicroseconds(opoznienie);
  }
}
void WyswietlBitmape(int j, int i, uint32_t c)
{
  if((bitmapa_przeksztalcona[j][i+9]==1) && (j!=107))
  {
    strip.setPixelColor(i, c);
  }
  else
  {
    strip.setPixelColor(i, 0);
  }
}

void PrzeksztalcBitmape()
{
  for(int a = 0; a<49; a++)
  {
    for(int b = 0; b < 49; b++)
    {
      if(bitmapa[a][b]==1)
      {
        int x = a-24;
        int y = b-24;
          float phi;
          if((x>0) && (y>=0))
          {
            phi = atan((float)y/x);
          }
          if((x>0) && (y<0))
          {
            phi = atan((float)y/x) + 6.28;
          }
          if(x<0)
          {
            phi = atan((float)y/x) + 3.14;
          }
          if((x==0) && (y>0))
          {
            phi = 3.14/2;
          }
          if((x==0) && (y<0))
          {
            phi = 3.14 * 3/2;
          }
          int promien = (int)round(sqrt((x * x) + (y * y)));
          int wyn = (int)round(phi / 0.05815);
          bitmapa_przeksztalcona[wyn][promien] = 1;
      }
    }
  }
}